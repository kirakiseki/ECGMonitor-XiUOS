## xiuos/Ubiquitous/XiZi_IIoT/board/edu-arm32/third_party_driver/spi/Kconfig
```kconfig
if BSP_USING_SPI
    config BSP_USING_SPI1
    bool "Using spi1"
    default y

    if BSP_USING_SPI1
        config SPI_BUS_NAME_1
            string "spi bus 1 name"
            default "spi1"
        config SPI_1_DEVICE_NAME_0
            string "spi bus 1 device 0 name"
            default "spi1_dev0" 
        config SPI_1_DRV_NAME
            string "spi bus 1 driver name"
            default "spi1_drv"

        menuconfig RESOURCES_SPI_LORA
            bool "Using spi lora function"
            default n
            if RESOURCES_SPI_LORA
                config SX12XX_DEVICE_NAME
                string "SX12XX(SX1278 SX1276) lora device name"
                default "spi1_lora"
            endif
    endif   

    config BSP_USING_SPI6
    bool "Using spi6"
    default n

    if BSP_USING_SPI6
        config SPI_BUS_NAME_6
            string "spi bus 6 name"
            default "spi6"
        config SPI_6_DEVICE_NAME_0
            string "spi bus 6 device 0 name"
            default "spi6_dev0" 
        config SPI_6_DRV_NAME
            string "spi bus 6 driver name"
            default "spi6_drv"
    endif  

    config BSP_USING_QSPI_FLASH
    bool "Using qspi and flash"
    default n

    if BSP_USING_QSPI_FLASH
        config QSPI_BUS_NAME
            string "qspi bus name"
            default "qspi"
        config QSPI_DEVICE_NAME_0
            string "qspi bus device 0 name"
            default "qspi_dev0" 
        config QSPI_DRV_NAME
            string "qspi bus driver name"
            default "qspi_drv"
        config QSPI_FLASH_DEV_NAME
            string "flash dev name"
            default "qspi_W25Q128"        
    endif  
endif
```

## xiuos/Ubiquitous/XiZi_IIoT/board/edu-arm32/third_party_driver/timer/Kconfig
```kconfig
menuconfig BSP_USING_HWTIMER
    bool "Using hwtimer"
    default y
    select RESOURCES_HWTIMER

if BSP_USING_HWTIMER
    config HWTIMER_BUS_NAME_0
        string "timer 0 bus 0 name"
        default "timer0"
    config HWTIMER_0_DEVICE_NAME_0
        string "timer 0 bus 0 device 0 name"
        default "timer0_dev0" 
    config HWTIMER_DRIVER_NAME_0
        string "timer 0 bus 0 driver name"
        default "timer0_drv"
endif
```

## xiuos/Ubiquitous/XiZi_IIoT/board/edu-arm32/third_party_driver/usart/Kconfig
```kconfig
menuconfig BSP_USING_UART3
    bool "Enable USART3"
    default y
    if BSP_USING_UART3
        config SERIAL_BUS_NAME_3
            string "serial bus 3 name"
            default "usart3"
        config SERIAL_DRV_NAME_3
            string "serial bus 3 driver name"
            default "usart3_drv"
        config SERIAL_3_DEVICE_NAME_0
            string "serial bus 3 device 0 name"
            default "usart3_dev3"   
    endif

menuconfig BSP_USING_UART6
    bool "Enable USART6"
    default n
    if BSP_USING_UART6
        config SERIAL_BUS_NAME_6
            string "serial bus 6 name"
            default "usart6"
        config SERIAL_DRV_NAME_6
            string "serial bus 6 driver name"
            default "usart6_drv"
        config SERIAL_6_DEVICE_NAME_0
            string "serial bus 6 device 0 name"
            default "usart6_dev6"   
    endif
```

## xiuos/Ubiquitous/XiZi_IIoT/board/edu-arm32/third_party_driver/usb/Kconfig
```kconfig
config BSP_USING_HC32_USBH
    bool "Using usb host by HC32 library"
    default y
    if BSP_USING_HC32_USBH
        config USB_BUS_NAME
            string "usb bus name"
            default "usb"
        config USB_DRIVER_NAME
            string "usb bus driver name"
            default "usb_drv"
        config USB_DEVICE_NAME
            string "usb bus device name"
            default "usb_dev"
        config MOUNT_USB_FS
            bool "mount usb file system : if y then not support sdcard-mount-fs"
            default y
            select MOUNT_USB

        if MOUNT_USB_FS
            config MOUNT_USB_FS_TYPE
                int "choose file system type : FATFS(0)"
                default 0 
        endif
    endif
```

## xiuos/Ubiquitous/XiZi_IIoT/board/edu-arm32/third_party_driver/watchdog/Kconfig
```kconfig
if BSP_USING_WDT
    config WDT_BUS_NAME_0
        string "watchdog bus 0 name"
        default "wdt0"

    config WDT_DRIVER_NAME_0
        string "watchdog driver 0 name"
        default "wdt0_drv"

    config WDT_0_DEVICE_NAME_0
        string "watchdog device 0 name"
        default "wdt0_dev0"
endif
```

## xiuos/Ubiquitous/XiZi_IIoT/board/edu-riscv64/third_party_driver/dvp/Kconfig
```kconfig
if BSP_USING_CAMERA
    config DVP_XCLK_RATE
        int "Camera interface clk rate"
        default 24000000
    config IMAGE_WIDTH
        int "Camera photo width"
        default 320
    config IMAGE_HEIGHT
        int "Camera photo height"
        default 240        
    config DVP_BURST_ENABLE
        bool "brust mode enable"
        default y
    config DVP_AUTO_ENABLE
        bool "auto recv image mode enable"
        default n
    config DVP_AI_OUTPUT
        bool "ai output enable"
        default n
    config DVP_INTERRUPT_ENABLE
        bool "interrupt enable"
        default y                   

    config CAMERA_BUS_NAME
        string "camera bus name"
        default "camera"
    config CAMERA_DRV_NAME
        string "camera driver name"
        default "camera_drv"
    config CAMERA_DEVICE_NAME
        string "camera device name"
        default "camera_dev"

    choice 
        prompt "set camera framesize and fps"
        default SVGA_25FPS_MODE

        config UXGA_15FPS_MODE
        bool "using uxga in 15fps"

        config SVGA_25FPS_MODE
        bool "using svag in 25fps"
    endchoice

    
endif
```

## xiuos/Ubiquitous/XiZi_IIoT/board/edu-riscv64/third_party_driver/kpu/Kconfig
```kconfig
if BSP_USING_KPU
    config KPU_DMA_CH
        int "KPU DMA channel number"
        default 5  

    config KPU_BUS_NAME
        string "kpu bus name"
        default "kpu"
    config KPU_DRV_NAME
        string "kpu driver name"
        default "kpu_drv"
    config KPU_DEVICE_NAME
        string "kpu device name"
        default "kpu_dev"
endif
```

## xiuos/Ubiquitous/XiZi_IIoT/board/edu-riscv64/third_party_driver/lcd/Kconfig
```kconfig
if BSP_USING_LCD
    config LCD_BUS_NAME
        string "lcd bus name"
        default "lcd"
    config LCD_DRV_NAME
        string "lcd bus driver name"
        default "lcd_drv"
    config LCD_DEVICE_NAME
            string "lcd bus device name"
            default "lcd_dev"   
    config BSP_LCD_CS_PIN
        int "CS pin number of 8080 interface"
        default 37
    config BSP_LCD_WR_PIN
        int "WR pin number of 8080 interface"
        default 38
    config BSP_LCD_DC_PIN
        int "DC pin number of 8080 interface"
        default 39
    config BSP_LCD_RST_PIN
        int "RST pin number of 8080 interface"
        default 36
    config FPIOA_LCD_DC
        int "DC FPIOA number of 8080 interface"
        default 9
    config FPIOA_LCD_RST
        int "RST FPIOA number of 8080 interface"
        default 10
    config BSP_LCD_X_MAX
        int "LCD Height"
        default 320
    config BSP_LCD_Y_MAX
        int "LCD Width"
        default 320
endif
```

## xiuos/Ubiquitous/XiZi_IIoT/board/imxrt1176-sbc/third_party_driver/Kconfig
```kconfig
menuconfig BSP_USING_LPUART
    bool "Using UART device"
    default y
    select RESOURCES_SERIAL
    if BSP_USING_LPUART
        source "$BSP_DIR/third_party_driver/uart/Kconfig"
    endif

menuconfig BSP_USING_GPIO
    bool "Using GPIO device "
    default y
    select RESOURCES_PIN

    if BSP_USING_GPIO
        source "$BSP_DIR/third_party_driver/gpio/Kconfig"
    endif

menuconfig BSP_USING_LWIP
    bool "Using LwIP device"
    default n
    select RESOURCES_LWIP

    if BSP_USING_LWIP
        source "$BSP_DIR/third_party_driver/ethernet/Kconfig"
    endif
```

## xiuos/Ubiquitous/XiZi_IIoT/board/imxrt1176-sbc/third_party_driver/ethernet/Kconfig
```kconfig
config BOARD_NETWORK_USE_100M_ENET_PORT
    bool "Enable 100M Enet Port"
    default y

config BOARD_NETWORK_USE_1G_ENET_PORT
    bool "Enable 1000M Enet Port"
    default y

config LWIP_REASSEMBLY_FRAG
    bool
    default y
```

## xiuos/Ubiquitous/XiZi_IIoT/board/xidatong-arm32/third_party_driver/Kconfig
```kconfig
menuconfig BSP_USING_LPUART
    bool "Using UART device"
    default y
    select RESOURCES_SERIAL
    if BSP_USING_LPUART
        source "$BSP_DIR/third_party_driver/uart/Kconfig"
    endif

menuconfig BSP_USING_CH438
    bool "Using CH438 device"
    default n
    if BSP_USING_CH438
        source "$BSP_DIR/third_party_driver/ch438/Kconfig"
    endif

menuconfig BSP_USING_GPIO
    bool "Using GPIO device "
    default y
    select RESOURCES_PIN
    if BSP_USING_GPIO
        source "$BSP_DIR/third_party_driver/gpio/Kconfig"
    endif
    
menuconfig BSP_USING_I2C
    bool "Using I2C device"
    default n
    select RESOURCES_I2C

    if BSP_USING_I2C
        source "$BSP_DIR/third_party_driver/i2c/Kconfig"
    endif

menuconfig BSP_USING_LWIP
    bool "Using LwIP device"
    default n
    select RESOURCES_LWIP

menuconfig BSP_USING_SEMC
    bool "Using SEMC device"
    default n
    if BSP_USING_SEMC
        source "$BSP_DIR/third_party_driver/semc/Kconfig"
    endif

menuconfig BSP_USING_SDIO
    bool "Using SD card device"
    default n
    select RESOURCES_SDIO
    if BSP_USING_SDIO
        source "$BSP_DIR/third_party_driver/sdio/Kconfig"
    endif

menuconfig BSP_USING_LCD
    bool "Using LCD device"
    default n
    select RESOURCES_LCD
    if BSP_USING_LCD
        source "$BSP_DIR/third_party_driver/lcd/Kconfig"
    endif
    
menuconfig BSP_USING_TOUCH
    bool "Using TOUCH device"
    default n
    select RESOURCES_TOUCH
    select BSP_USING_I2C
    select BSP_USING_LCD
    if BSP_USING_TOUCH
        source "$BSP_DIR/third_party_driver/touch/Kconfig"
    endif

menuconfig BSP_USING_USB
    bool "Using USB device"
    default n
    select RESOURCES_USB
    if BSP_USING_USB
        source "$BSP_DIR/third_party_driver/usb/Kconfig"
    endif

menuconfig BSP_USING_WDT
    bool "Using WATCHDOG TIMER device"
    default n
    select RESOURCES_WDT
    if BSP_USING_WDT
        source "$BSP_DIR/third_party_driver/wdt/Kconfig"
    endif
```

## xiuos/Ubiquitous/XiZi_IIoT/board/xidatong-arm32/third_party_driver/lcd/Kconfig
```kconfig
if BSP_USING_LCD
    config LCD_BUS_NAME
        string "lcd bus name"
        default "lcd"
    config LCD_DRV_NAME
        string "lcd bus driver name"
        default "lcd_drv"
    config LCD_DEVICE_NAME
        string "lcd bus device name"
        default "lcd_dev"  
    config LCD_BL_GPIO_PIN
        int "BackLight pin number of rgb565 interface"
        default 31
    config BSP_LCD_X_MAX
        int "LCD Height"
        default 272
    config BSP_LCD_Y_MAX
        int "LCD Width"
        default 480
    
endif
```

## xiuos/Ubiquitous/XiZi_IIoT/board/xidatong-arm32/third_party_driver/touch/Kconfig
```kconfig
if BSP_USING_TOUCH
    config TOUCH_BUS_NAME
        string "touch bus name"
        default "touch"
    config TOUCH_DRV_NAME
        string "touch bus driver name"
        default "touch_drv"
    config TOUCH_DEVICE_NAME
        string "touch bus device name"
        default "touch_dev" 
  
endif
```

## xiuos/Ubiquitous/XiZi_IIoT/board/xidatong-arm32/third_party_driver/uart/Kconfig
```kconfig
config BSP_USING_LPUART1
    bool "Enable LPUART1"
    default y
    if BSP_USING_LPUART1
        config SERIAL_BUS_NAME_1
            string "serial bus 1 name"
            default "uart1"
        config SERIAL_DRV_NAME_1
            string "serial bus 1 driver name"
            default "uart1_drv"
        config SERIAL_1_DEVICE_NAME_0
                string "serial bus 1 device name"
                default "uart1_dev1"   
    endif

config BSP_USING_LPUART2
    bool "Enable LPUART2"
    default y
    if BSP_USING_LPUART2
        config SERIAL_BUS_NAME_2
            string "serial bus 2 name"
            default "uart2"
        config SERIAL_DRV_NAME_2
            string "serial bus 2 driver name"
            default "uart2_drv"
        config SERIAL_2_DEVICE_NAME_0
                string "serial bus 2 device name"
                default "uart2_dev2"   
    endif

config BSP_USING_LPUART3
    bool "Enable LPUART3"
    default y
    if BSP_USING_LPUART3
        config SERIAL_BUS_NAME_3
            string "serial bus 3 name"
            default "uart3"
        config SERIAL_DRV_NAME_3
            string "serial bus 3 driver name"
            default "uart3_drv"
        config SERIAL_3_DEVICE_NAME_0
                string "serial bus 3 device name"
                default "uart3_dev3"   
    endif

config BSP_USING_LPUART4
    bool "Enable LPUART4"
    default n
    if BSP_USING_LPUART4
        config SERIAL_BUS_NAME_4
            string "serial bus 4 name"
            default "uart4"
        config SERIAL_DRV_NAME_4
            string "serial bus 4 driver name"
            default "uart4_drv"
        config SERIAL_4_DEVICE_NAME_0
                string "serial bus 4 device name"
                default "uart4_dev4"   
    endif

config BSP_USING_LPUART8
    bool "Enable LPUART8"
    default n
    if BSP_USING_LPUART8
        config SERIAL_BUS_NAME_8
            string "serial bus 8 name"
            default "uart8"
        config SERIAL_DRV_NAME_8
            string "serial bus 8 driver name"
            default "uart8_drv"
        config SERIAL_8_DEVICE_NAME_0
                string "serial bus 8 device name"
                default "uart8_dev8"   
    endif
```

## xiuos/Ubiquitous/XiZi_IIoT/board/xidatong-riscv64/Kconfig
```kconfig
mainmenu "XiZi_IIoT Project Configuration"

config BSP_DIR
    string
    option env="BSP_ROOT"
    default "."

config KERNEL_DIR
    string
    option env="KERNEL_ROOT"
    default "../.."

config BOARD_XIDATONG_RISCV64_EVB
    bool
    select  ARCH_RISCV
    select ARCH_RISCV64
    select ARCH_CPU_64BIT
    default y 

source "$KERNEL_DIR/arch/Kconfig"

menu "xidatong-riscv64 feature"
    source "$BSP_DIR/third_party_driver/Kconfig"

    menu "config default board resources"
        menu "config board app name"
            config BOARD_APP_NAME
                string "config board app name"
                default "/XiUOS_xidatong_riscv64_app.bin"
        endmenu

        menu "config board service table"
            config SERVICE_TABLE_ADDRESS
                hex "board service table address"
                default 0x80100000
        endmenu

        menu "config board peripheral"
            config MOUNT_SDCARD
                bool "mount sd card"
                default n
            config MOUNT_USB
                bool "mount usb"
                default n
        endmenu

    endmenu

    config __STACKSIZE__
        int "stack size for interrupt"
        default 4096

endmenu





menu "Hardware feature"
source "$KERNEL_DIR/resources/Kconfig"
endmenu

source "$KERNEL_DIR/Kconfig"
```

## xiuos/Ubiquitous/XiZi_IIoT/board/xidatong-riscv64/third_party_driver/ethernet/Kconfig
```kconfig
# Kconfig file

config BSP_USING_W5500
bool "Using w5500  "
default y

# if BSP_USING_W5500
    config BSP_WIZ_RST_PIN
        int 
        default 13

    config BSP_WIZ_INT_PIN
        int 
        default 14
# endif
```
