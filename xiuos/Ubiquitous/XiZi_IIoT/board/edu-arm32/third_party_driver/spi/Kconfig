## xiuos/Ubiquitous/XiZi_IIoT/board/xidatong-riscv64/third_party_driver/soft_spi/Kconfig
```kconfig
if BSP_USING_SOFT_SPI
        config SOFT_SPI_BUS_NAME
            string "soft spi bus 1 name"
            default "soft_spi1_bus1"
        
        config SOFT_SPI_DEVICE_NAME
            string "soft spi dev 1 name"
            default "soft_spi1_dev1" 

        config SOFT_SPI_DRV_NAME
            string "soft spi drv 1 name"
            default "soft_spi1_drv1"

        config SOFT_SPI_SCK
            int "soft spi sck pin"
            default 26

        config  SOFT_SPI_MOSI
            int "soft spi mosi pin"
            default 27

        config  SOFT_SPI_MISO
            int "soft spi miso pin"
            default 25

        config SOFT_SPI_CS0_PIN
            int "soft spi cs pin"
            default 28

        config SOFT_SPI_DEVICE_SLAVE_ID
            int "soft spi slave id"
            default 0
        
        config SOFT_SPI_CHIP_SELECT
            int "soft spi chip selected"
            default 0

        config SOFT_SPI_CLK_DELAY
            int "clk in microsecond"
            default 0
        
endif
```

## xiuos/Ubiquitous/XiZi_IIoT/board/xidatong-riscv64/third_party_driver/touch/Kconfig
```kconfig
if BSP_USING_TOUCH
    config TOUCH_BUS_NAME
        string "touch bus name"
        default "touch"
    config TOUCH_DRV_NAME
        string "touch bus driver name"
        default "touch_drv"
    config TOUCH_DEVICE_NAME
        string "touch bus device name"
        default "touch_dev" 
    config BSP_TOUCH_TP_INT
        int "touch int pin"
        default 36
    config FPIOA_TOUCH_TP_INT
        int "fpioa touch int pin"
        default 12
endif
```

## xiuos/Ubiquitous/XiZi_IIoT/board/xiwangtong-arm32/third_party_driver/uart/Kconfig
```kconfig
config BSP_USING_LPUART1
    bool "Enable LPUART1"
    default y
    if BSP_USING_LPUART1
        config SERIAL_BUS_NAME_1
            string "serial bus 1 name"
            default "uart1"
        config SERIAL_DRV_NAME_1
            string "serial bus 1 driver name"
            default "uart1_drv"
        config SERIAL_1_DEVICE_NAME_0
                string "serial bus 1 device name"
                default "uart1_dev1"   
    endif

config BSP_USING_LPUART2
    bool "Enable LPUART2"
    default y
    if BSP_USING_LPUART2
        config SERIAL_BUS_NAME_2
            string "serial bus 2 name"
            default "uart2"
        config SERIAL_DRV_NAME_2
            string "serial bus 2 driver name"
            default "uart2_drv"
        config SERIAL_2_DEVICE_NAME_0
                string "serial bus 2 device name"
                default "uart2_dev2"   
    endif

config BSP_USING_LPUART8
    bool "Enable LPUART8"
    default n
    if BSP_USING_LPUART8
        config SERIAL_BUS_NAME_8
            string "serial bus 8 name"
            default "uart8"
        config SERIAL_DRV_NAME_8
            string "serial bus 8 driver name"
            default "uart8_drv"
        config SERIAL_8_DEVICE_NAME_0
                string "serial bus 8 device name"
                default "uart8_dev8"   
    endif
```

## xiuos/Ubiquitous/XiZi_IIoT/board/xiwangtong-arm32/third_party_driver/usb/Kconfig
```kconfig
config BSP_USING_NXP_USBH
    bool "Using usb host by NXP library"
    default n
    if BSP_USING_NXP_USBH
        config USB_BUS_NAME
            string "usb bus name"
            default "usb"
        config USB_DRIVER_NAME
            string "usb bus driver name"
            default "usb_drv"
        config USB_DEVICE_NAME
            string "usb bus device name"
            default "usb_dev"
        config MOUNT_USB_FS
            bool "mount usb file system"
            default y
            select MOUNT_USB

        if MOUNT_USB_FS
            config MOUNT_USB_FS_TYPE
                int "choose file system type : FATFS(0) LWEXT4(3)"
                default 0 
        endif
    endif
```

## xiuos/Ubiquitous/XiZi_IIoT/lib/Kconfig
```kconfig
menu "Kernel Lib"

menuconfig LIB
    bool "Enable libc APIs from toolchain"
    default y

    if LIB 
        config LIB_POSIX
            bool "Enable POSIX layer for poll/select, stdin etc"
            default y
    endif

    choice 
        prompt "select libc"
        default LIB_NEWLIB

        config LIB_NEWLIB
            bool "use newlib as libc realization."

        config LIB_MUSLLIB
            bool "use musllib as libc realization."
        
        config LIB_OTHER
                bool "use other lib"

    endchoice

source "$KERNEL_DIR/lib/libcpp/Kconfig"

endmenu
```
