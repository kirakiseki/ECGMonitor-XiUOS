## xiuos/Ubiquitous/Nuttx_Fusion_XiUOS/aiit_board/xidatong-riscv64/Kconfig
```kconfig
#
# For a description of the syntax of this configuration file,
# see misc/tools/kconfig-language.txt.
#

if ARCH_BOARD_XIDATONG_RISCV64

menuconfig BSP_USING_CH376
    bool "Using CH376 device"
    default n
    select K210_UART
    select K210_UART3
    
if BSP_USING_CH376

choice
	prompt "select ch376 function."
	default CH376_USB_FUNCTION

config CH376_USB_FUNCTION
	bool "select ch376 usb function"

config CH376_SD_FUNCTION
	bool "select ch376 sd function"
endchoice

config CH376_WORK_MODE
	hex "ch376 work mode set:0x03 sd,0x06 u-disk"
	default 0x03 if CH376_SD_FUNCTION
	default 0x06 if CH376_USB_FUNCTION

endif # BSP_USING_CH376

menuconfig BSP_USING_ENET
    bool "Using ENET device"
    default n

menuconfig BSP_USING_TOUCH
    bool "Using touch device"
    default n

menuconfig BSP_USING_CAN
    select K210_UART
    select K210_UART1
    bool "Using CAN device"
    default n

menuconfig BSP_USING_CH438
    bool "Using CH438 device"
    default n

if BSP_USING_CH438
config CH438_EXTUART0
    bool "Using Ch438 Port 0"
    default n

menu "Ch438 Port 0 Configuration"
    depends on CH438_EXTUART0

    config CH438_EXTUART0_BAUD
        int "Ch438 Port 0 Baud Rate."
        default 115200
        ---help---
            The configured BAUD of the CH438 EXTUART0.
endmenu

config CH438_EXTUART1
    bool "Using Ch438 Port 1"
    default n

menu "Ch438 Port 1 Configuration"
    depends on CH438_EXTUART1

    config CH438_EXTUART1_BAUD
        int "Ch438 Port 1 Baud Rate."
        default 115200
        ---help---
            The configured BAUD of the CH438 EXTUART1.
endmenu

config CH438_EXTUART2
    bool "Using Ch438 Port 2"
    default n

menu "Ch438 Port 2 Configuration"
    depends on CH438_EXTUART2

    config CH438_EXTUART2_BAUD
        int "Ch438 Port 2 Baud Rate."
        default 115200
        ---help---
            The configured BAUD of the CH438 EXTUART2.
endmenu

config CH438_EXTUART3
    bool "Using Ch438 Port 3"
    default n

menu "Ch438 Port 3 Configuration"
    depends on CH438_EXTUART3

    config CH438_EXTUART3_BAUD
        int "Ch438 Port 3 Baud Rate."
        default 115200
        ---help---
            The configured BAUD of the CH438 EXTUART3.
endmenu

config CH438_EXTUART4
    bool "Using Ch438 Port 4"
    default n

menu "Ch438 Port 4 Configuration"
    depends on CH438_EXTUART4

    config CH438_EXTUART4_BAUD
        int "Ch438 Port 4 Baud Rate."
        default 115200
        ---help---
            The configured BAUD of the CH438 EXTUART4.
endmenu

config CH438_EXTUART5
    bool "Using Ch438 Port 5"
    default n

menu "Ch438 Port 5 Configuration"
    depends on CH438_EXTUART5

    config CH438_EXTUART5_BAUD
        int "Ch438 Port 5 Baud Rate."
        default 115200
        ---help---
            The configured BAUD of the CH438 EXTUART5.
endmenu

config CH438_EXTUART6
    bool "Using Ch438 Port 6"
    default n

menu "Ch438 Port 6 Configuration"
    depends on CH438_EXTUART6

    config CH438_EXTUART6_BAUD
        int "Ch438 Port 6 Baud Rate."
        default 115200
        ---help---
            The configured BAUD of the CH438 EXTUART6.
endmenu

config CH438_EXTUART7
    bool "Using Ch438 Port 7"
    default n

menu "Ch438 Port 7 Configuration"
    depends on CH438_EXTUART7

    config CH438_EXTUART7_BAUD
        int "Ch438 Port 7 Baud Rate."
        default 115200
        ---help---
            The configured BAUD of the CH438 EXTUART7.
endmenu

endif # BSP_USING_CH438
endif # ARCH_BOARD_XIDATONG_RISCV64
```

## xiuos/Ubiquitous/Nuttx_Fusion_XiUOS/app_match_nuttx/apps/examples/e22_demo/Kconfig
```kconfig
#
# For a description of the syntax of this configuration file,
# see the file kconfig-language.txt in the NuttX tools repository.
#

config EXAMPLES_E22
	tristate "E22 driver example"
	default n
	depends on STM32_USART3
	---help---
		Enable the e22 driver example

if EXAMPLES_E22

config EXAMPLES_E22_PROGNAME
	string "Program name"
	default "e22"
	---help---
		This is the name of the program that will be used when the NSH ELF
		program is installed.

config EXAMPLES_E22_PRIORITY
	int "E22 task priority"
	default 100

config EXAMPLES_E22_STACKSIZE
	int "E22 stack size"
	default DEFAULT_TASK_STACKSIZE

endif
```

## xiuos/Ubiquitous/Nuttx_Fusion_XiUOS/app_match_nuttx/nuttx/arch/arm/src/hc32/Kconfig
```kconfig
#
# For a description of the syntax of this configuration file,
# see the file kconfig-language.txt in the NuttX tools repository.
#

comment "HC32 Configuration Options"

choice
	prompt "HC32 Chip Selection"
	default HC32F4A0_CHIP

config HC32F4A0_CHIP
	bool "HC32F4A0"
	---help---

endchoice


menu "HC32 U[S]ART Selection"

config HC32_UART1
	bool "UART1"
	default n
    select UART_SERIALDRIVER
    select UART1_SERIALDRIVER
	select HC32_UART1_SERIALDRIVER
	select ARCH_HAVE_SERIAL_TERMIOS
	select HC32_UART

config HC32_UART2
	bool "UART2"
	default n
	select HC32_UART2_SERIALDRIVER
    select UART_SERIALDRIVER
    select UART2_SERIALDRIVER
	select ARCH_HAVE_SERIAL_TERMIOS
	select HC32_UART

config HC32_UART3
	bool "UART3"
	default n
	select ARCH_HAVE_SERIAL_TERMIOS
    select UART_SERIALDRIVER
    select UART3_SERIALDRIVER
	select HC32_UART3_SERIALDRIVER
	select HC32_UART

config HC32_UART4
	bool "UART4"
	default n
	select ARCH_HAVE_SERIAL_TERMIOS
    select UART_SERIALDRIVER
    select UART4_SERIALDRIVER
	select HC32_UART4_SERIALDRIVER
	select HC32_UART

config HC32_UART5
	bool "UART5"
	default n
	select ARCH_HAVE_SERIAL_TERMIOS
    select UART_SERIALDRIVER
    select UART5_SERIALDRIVER
	select HC32_UART5_SERIALDRIVER
	select HC32_UART

config HC32_UART6
	bool "UART6"
	default n
	select ARCH_HAVE_SERIAL_TERMIOS
    select UART_SERIALDRIVER
    select UART6_SERIALDRIVER
	select HC32_UART6_SERIALDRIVER
	select HC32_UART

config HC32_UART6_SERIALDRIVER
    bool "UART6SERIAL"
	default n

if HC32_UART6

menu "UART6 Configuration"
	depends on UART6_SERIALDRIVER

config UART6_RXBUFSIZE
	int "Receive buffer size"
	default 256
	---help---
		Characters are buffered as they are received. This specifies
		the size of the receive buffer.

config UART6_TXBUFSIZE
	int "Transmit buffer size"
	default 256
	---help---
		Characters are buffered before being sent.  This specifies
		the size of the transmit buffer.

config UART6_BAUD
	int "BAUD rate"
	default 115200
	---help---
		The configured BAUD of the UART.

config UART6_BITS
	int "Character size"
	default 8
	---help---
		The number of bits.  Must be either 7 or 8.

config UART6_PARITY
	int "Parity setting"
	range 0 2
	default 0
	---help---
		0=no parity, 1=odd parity, 2=even parity

config UART6_2STOP
	int "use 2 stop bits"
	default 0
	---help---
		1=Two stop bits

config UART6_IFLOWCONTROL
	bool "UART6 RTS flow control"
	default n
	select SERIAL_IFLOWCONTROL
	---help---
		Enable UART6 RTS flow control

config UART6_OFLOWCONTROL
	bool "UART6 CTS flow control"
	default n
	select SERIAL_OFLOWCONTROL
	---help---
		Enable UART6 CTS flow control

config UART6_RXDMA
	bool "UART6 Rx DMA support"
	default n
	select SERIAL_RXDMA
	---help---
		Enable Rx DMA transfers on UART6

config UART6_TXDMA
	bool "UART6 Tx DMA support"
	default n
	select SERIAL_TXDMA
	---help---
		Enable Tx DMA transfers on UART6

endmenu

endif

config HC32_UART7
	bool "UART7"
	default n
	select ARCH_HAVE_SERIAL_TERMIOS
    select UART_SERIALDRIVER
    select UART7_SERIALDRIVER
	select HC32_UART7_SERIALDRIVER
	select HC32_UART

config HC32_UART8
	bool "UART8"
	default n
	select ARCH_HAVE_SERIAL_TERMIOS
    select UART_SERIALDRIVER
    select UART8_SERIALDRIVER
	select HC32_UART8_SERIALDRIVER
	select HC32_UART

endmenu # HC32 U[S]ART Selection

config HC32_SPI1
	bool "SPI1"
	default n
	select SPI
	select HC32_SPI

config HC32_SPI2
	bool "SPI2"
	default n
	select SPI
	select HC32_SPI

config HC32_I2C1
	bool "I2C1"
	default n
	select I2C
	select HC32_I2C

config HC32_I2C2
	bool "I2C2"
	default n
	select I2C
	select HC32_I2C

config HC32_I2C3
	bool "I2C3"
	default n
	select I2C
	select HC32_I2C


config HC32_SPI
	bool

config HC32_I2C
	bool

config HC32_CAN
	bool
```
