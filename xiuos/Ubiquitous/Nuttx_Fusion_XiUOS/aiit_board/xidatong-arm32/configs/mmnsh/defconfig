## xiuos/Ubiquitous/XiZi_IIoT/board/edu-arm32/third_party_driver/Kconfig
```kconfig
menuconfig BSP_USING_UART
    bool "Using UART device"
    default y
    select RESOURCES_SERIAL
    if BSP_USING_UART
        source "$BSP_DIR/third_party_driver/usart/Kconfig"
    endif

menuconfig BSP_USING_ADC
bool "Using ADC device"
default n
select RESOURCES_ADC
if BSP_USING_ADC
source "$BSP_DIR/third_party_driver/adc/Kconfig"
endif

menuconfig BSP_USING_DAC
bool "Using DAC device"
default n
select RESOURCES_DAC
if BSP_USING_DAC
source "$BSP_DIR/third_party_driver/dac/Kconfig"
endif


menuconfig BSP_USING_GPIO
    bool "Using GPIO device "
    default y
    select RESOURCES_PIN
    if BSP_USING_GPIO
        source "$BSP_DIR/third_party_driver/gpio/Kconfig"
    endif

menuconfig BSP_USING_LWIP
    bool "Using LwIP by ethernet device"
    default n
    select RESOURCES_LWIP
    if BSP_USING_LWIP
        source "$BSP_DIR/third_party_driver/ethernet/Kconfig"
    endif

menuconfig BSP_USING_SPI
    bool "Using SPI device"
    default n
    select RESOURCES_SPI
    if BSP_USING_SPI
        source "$BSP_DIR/third_party_driver/spi/Kconfig"
    endif

menuconfig BSP_USING_I2C
    bool "Using I2C device"
    default n
    select RESOURCES_I2C
    if BSP_USING_I2C
        source "$BSP_DIR/third_party_driver/i2c/Kconfig"
    endif

menuconfig BSP_USING_SDIO
    bool "Using SD CARD device"
    default n
    select RESOURCES_SDIO
    if BSP_USING_SDIO
        source "$BSP_DIR/third_party_driver/sdio/Kconfig"
    endif

menuconfig BSP_USING_USB
    bool "Using USB device"
    default n
    select RESOURCES_USB
    if BSP_USING_USB
        source "$BSP_DIR/third_party_driver/usb/Kconfig"
    endif

menuconfig BSP_USING_RTC
    bool "Using RTC device"
    default n
    select RESOURCES_RTC
    if BSP_USING_RTC
        source "$BSP_DIR/third_party_driver/rtc/Kconfig"
    endif

menuconfig BSP_USING_WDT
    bool "Using WDT device"
    default n
    select RESOURCES_WDT
    if BSP_USING_WDT
        source "$BSP_DIR/third_party_driver/watchdog/Kconfig"
    endif

menuconfig BSP_USING_TIMER
    bool "Using TIMER device"
    default n
    select RESOURCES_TIMER
    if BSP_USING_TIMER
        source "$BSP_DIR/third_party_driver/timer/Kconfig"
    endif

menuconfig BSP_USING_CAN
    bool "Using CAN device"
    default n
    select RESOURCES_CAN
    if BSP_USING_CAN
        source "$BSP_DIR/third_party_driver/can/Kconfig"
    endif
```

## xiuos/Ubiquitous/XiZi_IIoT/board/edu-arm32/third_party_driver/can/Kconfig
```kconfig
config CAN_BUS_NAME_2
    string "can bus name"
    default "can2"

config CAN_DRIVER_NAME_2
    string "can driver name"
    default "can2_drv"

config CAN_2_DEVICE_NAME_1
    string "can bus 1 device 1 name"
    default "can2_dev1"

config CAN_USING_INTERRUPT
    bool "can interrupt open"
    default n
```

## xiuos/Ubiquitous/XiZi_IIoT/board/edu-arm32/third_party_driver/i2c/Kconfig
```kconfig
config I2C_BUS_NAME_1
    string "i2c 1 bus name"
    default "i2c1"
config I2C_DRV_NAME_1
    string "i2c bus 1 driver name"
    default "i2c1_drv"
config I2C_1_DEVICE_NAME_0
    string "i2c bus 1 device 0 name"
    default "i2c1_dev0"
config I2C_DEVICE_MODE
    bool "choose i2c device mode as master or slave"
    default y
    choice
        prompt "choose i2c mode"
        default I2C_DEVICE_MASTER

        config I2C_DEVICE_MASTER
            bool "set i2c master"
        
        config I2C_DEVICE_SLAVE
            bool "set i2c slave"
    endchoice
```

## xiuos/Ubiquitous/XiZi_IIoT/board/edu-arm32/third_party_driver/sdio/Kconfig
```kconfig
if BSP_USING_SDIO
    config SDIO_BUS_NAME
        string "sdio bus name"
        default "sdio"

    config SDIO_DRIVER_NAME
        string "sdio driver name"
        default "sdio_drv"

    config SDIO_DEVICE_NAME
        string "sdio device name"
        default "sdio_dev"

    config MOUNT_SDCARD_FS
        bool "mount sd card file system : if y then not support usb-mount-fs"
        default y
        select MOUNT_SDCARD

    if MOUNT_SDCARD_FS
        config MOUNT_SDCARD_FS_TYPE
            int "choose file system type : FATFS(0)"
            default 0 
    endif
endif
```
