## xiuos/APP_Framework/Framework/connection/industrial_network/Kconfig
```kconfig
config CONNECTION_ADAPTER_ETHERCAT
    bool "Using EtherCAT on industrial network adapter device"
    default n

    if CONNECTION_ADAPTER_ETHERCAT
        source "$APP_DIR/Framework/connection/industrial_network/ethercat/Kconfig"
    endif

config CONNECTION_ADAPTER_POWERLINK
    bool "Using POWERLINK on industrial network adapter device"
    default n

    if CONNECTION_ADAPTER_POWERLINK
        source "$APP_DIR/Framework/connection/industrial_network/powerlink/Kconfig"
    endif
```

## xiuos/APP_Framework/Framework/connection/industrial_network/powerlink/Kconfig
```kconfig
config POWERLINK_MN
    bool "Using powerlink MN"
    default n

config POWERLINK_CN
    bool "Using powerlink CN"
    default n
```

## xiuos/APP_Framework/Framework/connection/lora/e22/Kconfig
```kconfig
config ADAPTER_LORA_E22
        string "E22-400T30S adapter name"
        default "e22"

if ADD_NUTTX_FEATURES

        config ADAPTER_E22_M0_PATH
                string "E22 M0 pin device"
                default "/dev/gpio0"

        config ADAPTER_E22_M1_PATH
                string "E22 M1 pin device"
                default "/dev/gpio1"
        
        config ADAPTER_E22_DRIVER_EXTUART
                bool "Using extra uart to support lora"
                default n

        config ADAPTER_E22_DRIVER
                string "E22 device uart driver path"
                default "/dev/ttyS2"
                depends on !ADAPTER_E22_DRIVER_EXTUART

        if ADAPTER_E22_DRIVER_EXTUART                    
                config ADAPTER_E22_DRIVER
                        string "E22 device extra uart driver path"
                        default "/dev/extuart_dev3"

                config ADAPTER_E22_DRIVER_EXT_PORT
                        int "if E22 device using extuart, choose port"
                        default "3"
        endif

endif
```

## xiuos/APP_Framework/Framework/connection/wifi/esp07s_wifi/Kconfig
```kconfig
config ADAPTER_WIFI_ESP07S
        string "ESP07S WIFI adapter name"
        default "esp07s_wifi"

if ADD_XIZI_FEATURES

        config ADAPTER_ESP07S_DRIVER_EXTUART
                bool "Using extra uart to support wifi"
                default n

        config ADAPTER_ESP07S_DRIVER
                string "ESP07S device uart driver path"
                default "/dev/ttyS2"
                depends on !ADAPTER_ESP07S_DRIVER_EXTUART

        if ADAPTER_ESP07S_DRIVER_EXTUART
                config ADAPTER_ESP07S_DRIVER
                        string "ESP07S device extra uart driver path"
                        default "/dev/extuart_dev6"

                config ADAPTER_ESP07S_DRIVER_EXT_PORT
                        int "if ESP07S device using extuart, choose port"
                        default "6"
        endif
endif

if ADD_NUTTX_FEATURES
        config ADAPTER_ESP07S_DRIVER_EXTUART
                bool "Using extra uart to support wifi"
                default n

        config ADAPTER_ESP07S_DRIVER
                string "ESP07S device uart driver path"
                default "/dev/uart2_dev2"
                depends on !ADAPTER_ESP07S_DRIVER_EXTUART

        if ADAPTER_ESP07S_DRIVER_EXTUART
                config ADAPTER_ESP07S_DRIVER
                        string "ESP07S device extra uart driver path"
                        default "/dev/extuart_dev6"

                config ADAPTER_ESP07S_DRIVER_EXT_PORT
                        int "if ESP07S device using extuart, choose port"
                        default "6"
        endif
endif

if ADD_RTTHREAD_FEATURES
        if ADD_RTTHREAD_FEATURES
        config ADAPTER_ESP07S_DRIVER_EXTUART
                bool "Using extra uart to support wifi"
                default n

        config ADAPTER_ESP07S_DRIVER
                string "ESP07S device uart driver path"
                default "/dev/uart2"
                depends on !ADAPTER_ESP07S_DRIVER_EXTUART

        if ADAPTER_ESP07S_DRIVER_EXTUART_RT                    
                config ADAPTER_ESP07S_DRIVER
                        string "ESP07S device extra uart driver path"
                        default "/dev/extuart_dev6_rt"

                config ADAPTER_ESP07S_DRIVER_EXT_PORT
                        int "if ESP07S device using extuart, choose port"
                        default "6"
        endif
endif

endif
```

## xiuos/APP_Framework/Framework/connection/wifi/esp8285_wifi/Kconfig
```kconfig
config ADAPTER_WIFI_ESP8285
        string "ESP8285 WIFI adapter name"
        default "esp8285_wifi"

if ADD_NUTTX_FEATURES
        config ADAPTER_ESP8285_DRIVER
                string "ESP8285 device uart driver path"
                default "/dev/ttyS1"
endif

if ADD_XIZI_FEATURES
        config ADAPTER_ESP8285_DRIVER
                string "ESP8285 device uart driver path"
                default "/dev/uart1_dev1"
endif
```

## xiuos/APP_Framework/Framework/control/Kconfig
```kconfig
menuconfig SUPPORT_CONTROL_FRAMEWORK
    bool "support control framework"
    default n
    select TRANSFORM_LAYER_ATTRIUBUTE
    select BSP_USING_SDIO
    select MOUNT_SDCARD_FS
    select LIB_USING_CJSON

if SUPPORT_CONTROL_FRAMEWORK
    config CONTROL_USING_SERIAL_485
        bool
        default n

    config CONTROL_USING_SOCKET
        bool
        default n
    if CONTROL_USING_SOCKET
        choice
            prompt "select socket lib"
            default CONTROL_SOCKET_LWIP
        
            config CONTROL_SOCKET_LWIP
                bool "support socket, using LwIP"
                select BSP_USING_LWIP
            
            config CONTROL_SOCKET_W5500
                bool "support socket, using W5500"
                select BSP_USING_W5500
        endchoice
    endif

    config CONTROL_RECIPE_FILE
        string "control framework recipe file name"
        default "test_recipe.json"

    menuconfig CONTROL_IPC_PROTOCOL
        bool "Using ipc protocol"
        default n
    if CONTROL_IPC_PROTOCOL
        source "$APP_DIR/Framework/control/ipc_protocol/Kconfig"
    endif

    menuconfig CONTROL_PLC_PROTOCOL
        bool "Using plc protocol"
        default n
    if CONTROL_PLC_PROTOCOL
        source "$APP_DIR/Framework/control/plc_protocol/Kconfig"
    endif
    
endif
```

## xiuos/APP_Framework/Framework/control/ipc_protocol/Kconfig
```kconfig
config CONTROL_PROTOCOL_MODBUS_TCP
        bool "Using modbus_tcp control protocol"
        default n
        select CONTROL_USING_SOCKET
if CONTROL_PROTOCOL_MODBUS_TCP
        source "$APP_DIR/Framework/control/ipc_protocol/modbus_tcp/Kconfig"
endif

config CONTROL_PROTOCOL_MODBUS_UART
        bool "Using modbus_uart control protocol"
        default n
        select CONTROL_USING_SERIAL_485
if CONTROL_PROTOCOL_MODBUS_UART
        source "$APP_DIR/Framework/control/ipc_protocol/modbus_uart/Kconfig"
endif
```

## xiuos/APP_Framework/Framework/control/ipc_protocol/modbus_uart/Kconfig
```kconfig
if ADD_XIZI_FEATURES
        config CONTROL_FRAMEWORK_UART_485_DIR
                int "control framework 485 direction pin number"
                default "2"

        config CONTROL_FRAMEWORK_PIN_DEV
                string "control framework device pin dev path"
                default "/dev/pin_dev"             

        config CONTROL_FRAMEWORK_DRIVER_EXTUART
                bool "Using extra uart to control framework"
                default n

        config CONTROL_FRAMEWORK_UART_DEV
                string "control framework device uart dev path"
                default "/dev/uart3_dev3"
                depends on !CONTROL_FRAMEWORK_DRIVER_EXTUART

        if CONTROL_FRAMEWORK_DRIVER_EXTUART                    
                config CONTROL_FRAMEWORK_UART_DEV
                        string "control framework device extra uart dev path"
                        default "/dev/extuart_dev0"

                config CONTROL_FRAMEWORK_DEV_EXT_PORT
                        int "if control framework device using extuart, choose port"
                        default "0"
        endif
endif

if ADD_NUTTX_FEATURES

endif

if ADD_RTTHREAD_FEATURES

endif
```

## xiuos/APP_Framework/Framework/control/plc_protocol/Kconfig
```kconfig
config CONTROL_PROTOCOL_FINS
        bool "Using fins control protocol"
        default n
        select CONTROL_USING_SOCKET
if CONTROL_PROTOCOL_FINS
        source "$APP_DIR/Framework/control/plc_protocol/fins/Kconfig"
endif

config CONTROL_PROTOCOL_MELSEC
        bool "Using melsec control protocol"
        default n
if CONTROL_PROTOCOL_MELSEC
        source "$APP_DIR/Framework/control/plc_protocol/melsec/Kconfig"
endif

config CONTROL_PROTOCOL_OPCUA
        bool "Using opcua control protocol"
        default n
if CONTROL_PROTOCOL_OPCUA
        source "$APP_DIR/Framework/control/plc_protocol/opcua/Kconfig"
endif

config CONTROL_PROTOCOL_S7
        bool "Using s7 control protocol"
        default n
        select CONTROL_USING_SOCKET
if CONTROL_PROTOCOL_S7
        source "$APP_DIR/Framework/control/plc_protocol/s7/Kconfig"
endif
```

## xiuos/APP_Framework/Framework/control/plc_protocol/melsec/Kconfig
```kconfig
choice
    prompt "select melsec protocol"
    default CONTROL_PROTOCOL_MELSEC_1E

    config CONTROL_PROTOCOL_MELSEC_1E
        bool "support melsec_1e protocol, using SOCKET"
        select CONTROL_USING_SOCKET
    
    config CONTROL_PROTOCOL_MELSEC_3E_Q_L
        bool "support melsec_3e_q_l protocol, using SOCKET"
        select CONTROL_USING_SOCKET

    config CONTROL_PROTOCOL_MELSEC_3E_IQ_R
        bool "support melsec_3e_iq_r protocol, using SOCKET"
        select CONTROL_USING_SOCKET

    config CONTROL_PROTOCOL_MELSEC_1C
        bool "support melsec_1c protocol, using SERIAL"
        select CONTROL_USING_SERIAL_485

    config CONTROL_PROTOCOL_MELSEC_3C
        bool "support melsec_3c protocol, using SERIAL"
        select CONTROL_USING_SERIAL_485
endchoice

if CONTROL_USING_SERIAL_485
    if ADD_XIZI_FEATURES
            config CONTROL_FRAMEWORK_UART_485_DIR
                    int "control framework 485 direction pin number"
                    default "2"

            config CONTROL_FRAMEWORK_PIN_DEV
                    string "control framework device pin dev path"
                    default "/dev/pin_dev"             

            config CONTROL_FRAMEWORK_DRIVER_EXTUART
                    bool "Using extra uart to control framework"
                    default n

            config CONTROL_FRAMEWORK_UART_DEV
                    string "control framework device uart dev path"
                    default "/dev/uart3_dev3"
                    depends on !CONTROL_FRAMEWORK_DRIVER_EXTUART

            if CONTROL_FRAMEWORK_DRIVER_EXTUART                    
                    config CONTROL_FRAMEWORK_UART_DEV
                            string "control framework device extra uart dev path"
                            default "/dev/extuart_dev0"

                    config CONTROL_FRAMEWORK_DEV_EXT_PORT
                            int "if control framework device using extuart, choose port"
                            default "0"
            endif
    endif

    if ADD_NUTTX_FEATURES

    endif

    if ADD_RTTHREAD_FEATURES

    endif

endif
```

## xiuos/APP_Framework/Framework/knowing/kpu/k210_yolov2_detect_procedure/Kconfig
```kconfig
menuconfig USING_K210_YOLOV2_DETECT
    bool "k210 yolov2 detect procedure"
	depends on USING_KPU_PROCESSING
    default n

config KPU_DEV_DRIVER
    string "Set kpu dev path"
    default "/dev/kpu_dev"

config CAMERA_DEV_DRIVER
    string "Set camera dev path for kpu"
    default "/dev/ov2640"

config KPU_LCD_DEV_DRIVER
    string "Set lcd dev path for kpu"
    default "/dev/lcd_dev"
```

## xiuos/APP_Framework/Framework/security/Kconfig
```kconfig
menu "Security"

menuconfig CRYPTO
    bool "using crypto"
    default n
    select TRANSFORM_LAYER_ATTRIUBUTE
if CRYPTO
    menuconfig CRYPTO_SM3
        bool "using sm3"
        default n

    menuconfig CRYPTO_SM4
        bool "using sm4"
        default n

    menuconfig CRYPTO_SM9
        select CRYPTO_SM3
        select CRYPTO_SM4
        bool "using sm9"

        default n
endif

menuconfig MBEDTLS
    bool "using mbedtls"
    default n
    select MBEDTLS_ENABLE
if MBEDTLS
    menuconfig ENABLE_MBEDTLS_TEST
        bool "enable test"
        default n
endif

endmenu
```

## xiuos/APP_Framework/Framework/sensor/ecgadc/Kconfig
```kconfig
config SENSOR_ADS1115_ADC
        bool "Using ADS1115 for ECG-ADC"
        default n

        if SENSOR_ADS1115_ADC
                config SENSOR_DEVICE_ADS1115
                        string "ADS1115 sensor name"
                        default "ADS1115_1"
                
                config SENSOR_QUANTITY_ADS1115_ECGADC
                        string "ADS1115 quantity name"
                        default "adc_1"
                
                if ADD_XIZI_FEATURES
                        config SENSOR_DEVICE_ADS1115_DEV
                                string "ADS1115 device name"
                                default "/dev/i2c1_dev0"
                                
                        config SENSOR_DEVICE_ADS1115_I2C_ADDR
                                hex "ADS1115 device i2c address"
                                default 0x48
                endif

                if ADD_NUTTX_FEATURES
                        config SENSOR_DEVICE_ADS1115_DEV
                                string "ADS1115 device name"
                                default "/dev/i2c1_dev0"
                        
                        config SENSOR_DEVICE_ADS1115_I2C_ADDR
                                hex "ADS1115 device i2c address"
                                default 0x48

                endif

                if ADD_RTTHREAD_FEATURES
                        config SENSOR_DEVICE_ADS1115_DEV
                                string "ADS1115 device name"
                                default "/dev/i2c1"
                       config SENSOR_DEVICE_ADS1115_I2C_ADDR
                                hex "ADS1115 device i2c address"
                                default 0x48

                endif
        endif
```

## xiuos/APP_Framework/lib/cJSON/Kconfig
```kconfig
menu "lib using cJSON"
    menuconfig LIB_USING_CJSON
        bool "USING cJSON"
        default n
endmenu
```

## xiuos/APP_Framework/lib/lorawan/Kconfig
```kconfig
menu "lib using LoRaWan"

menuconfig LIB_USING_LORAWAN
    bool "Using LoRaWan lib"
    default n

    if LIB_USING_LORAWAN
        menuconfig LIB_USING_LORAWAN_GATEWAY_SC
            help 
                Please add "source "$APP_DIR/lib/lorawan/lorawan_gateway_single_channel/Kconfig"" when using lorawan_gateway_single_channel
            bool "LoRaWan using lorawan_gateway for single channel(SX126x/SX127x) lib"
            default n
            select LIB_USING_LORA_RADIO
            select BSP_USING_LWIP

        if LIB_USING_LORAWAN_GATEWAY_SC
            
        endif

        menuconfig LIB_USING_LORAWAN_ED_STACK
            help 
                Please add "source "$APP_DIR/lib/lorawan/lorawan_devicenode/Kconfig"" when using lorawan_devicenode
            bool "LoRaWan using lorawan_ed_stack lib"
            default n
            select LIB_USING_LORA_RADIO

        if LIB_USING_LORAWAN_ED_STACK

        endif

        menuconfig LIB_USING_LORA_RADIO
            help
                Please add "source "$APP_DIR/lib/lorawan/lora_radio_driver/Kconfig"" when using lora_radio_driver
            bool "LoRaWan using lora-radio-driver lib"
            default n
            select BSP_USING_SPI

        if LIB_USING_LORA_RADIO

        endif
    endif

endmenu
```
