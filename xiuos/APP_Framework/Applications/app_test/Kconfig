## xiuos/Ubiquitous/Nuttx_Fusion_XiUOS/aiit_board/edu-riscv64/Kconfig
```kconfig
#
# For a description of the syntax of this configuration file,
# see misc/tools/kconfig-language.txt.
#

if ARCH_BOARD_EDU_RISCV64

menuconfig BSP_USING_CH376
    bool "Using CH376 device"
    default n
    select K210_UART
    select K210_UART3

menuconfig BSP_USING_ENET
    bool "Using ENET device"
    default n

endif # ARCH_BOARD_EDU_RISCV64
```

## xiuos/Ubiquitous/Nuttx_Fusion_XiUOS/aiit_board/hc32f4a0/Kconfig
```kconfig
#
# For a description of the syntax of this configuration file,
# see the file kconfig-language.txt in the NuttX tools repository.
#

if ARCH_BOARD_HC32F4A0

config HC32F4A0_BOARD
	bool "HDSC HC32F4A0 base board"
	default n
	---help---
		Select if you are using the HC32F4A0 base board with the HC32F4A0.

config HC32_ROMFS
	bool "Automount baked-in ROMFS image"
	default n
	depends on FS_ROMFS
	---help---
		Select HC32_ROMFS_IMAGEFILE, HC32_ROMFS_DEV_MINOR, HC32_ROMFS_MOUNTPOINT

config HC32_ROMFS_DEV_MINOR
	int "Minor for the block device backing the data"
	depends on HC32_ROMFS
	default 64

config HC32_ROMFS_MOUNTPOINT
	string "Mountpoint of the custom romfs image"
	depends on HC32_ROMFS
	default "/rom"

config HC32_ROMFS_IMAGEFILE
	string "ROMFS image file to include into build"
	depends on HC32_ROMFS
	default "../../../../../rom.img"


endif
```

## xiuos/Ubiquitous/Nuttx_Fusion_XiUOS/aiit_board/xidatong-arm32/Kconfig
```kconfig
#
# For a description of the syntax of this configuration file,
# see the file kconfig-language.txt in the NuttX tools repository.
#

if ARCH_BOARD_XIDATONG_ARM32

choice
    prompt "Boot Flash"
    default XIDATONG_ARM32_QSPI_FLASH

config XIDATONG_ARM32_HYPER_FLASH
    bool "HYPER Flash"

config XIDATONG_ARM32_QSPI_FLASH
    bool "QSPI Flash"

endchoice # Boot Flash

config XIDATONG_ARM32_SDRAM
    bool "Enable SDRAM"
    default y
    select IMXRT_SEMC_INIT_DONE
    ---help---
        Activate DCD configuration of SDRAM

config XIDATONG_ARM32_SDIO_AUTOMOUNT
    bool "SD card automounter"
    default n
    depends on FS_AUTOMOUNTER && IMXRT_USDHC

if XIDATONG_ARM32_SDIO_AUTOMOUNT

config XIDATONG_ARM32_SDIO_AUTOMOUNT_FSTYPE
    string "SD card file system type"
    default "vfat"

config XIDATONG_ARM32_SDIO_AUTOMOUNT_BLKDEV
    string "SD card block device"
    default "/dev/mmcsd0"

config XIDATONG_ARM32_SDIO_AUTOMOUNT_MOUNTPOINT
    string "SD card mount point"
    default "/mnt/sdcard"

config XIDATONG_ARM32_SDIO_AUTOMOUNT_DDELAY
    int "SD card debounce delay (milliseconds)"
    default 1000

config XIDATONG_ARM32_SDIO_AUTOMOUNT_UDELAY
    int "SD card unmount retry delay (milliseconds)"
    default 2000

endif # XIDATONG_ARM32_SDIO_AUTOMOUNT

config XIDATONG_ARM32_USB_AUTOMOUNT
    bool "USB Mass Storage automounter"
    default n
    depends on USBHOST_MSC && USBHOST_MSC_NOTIFIER

if XIDATONG_ARM32_USB_AUTOMOUNT

config XIDATONG_ARM32_USB_AUTOMOUNT_FSTYPE
    string "USB file system type"
    default "vfat"

config XIDATONG_ARM32_USB_AUTOMOUNT_BLKDEV
    string "USB block device prefix"
    default "/dev/sd"

config XIDATONG_ARM32_USB_AUTOMOUNT_MOUNTPOINT
    string "USB mount point prefix"
    default "/mnt/usb"

config XIDATONG_ARM32_USB_AUTOMOUNT_NUM_BLKDEV
    int "Number of block devices to monitor."
    range 1 26
    default 4

config XIDATONG_ARM32_USB_AUTOMOUNT_UDELAY
    int "USB unmount retry delay (milliseconds)"
    default 2000

endif # XIDATONG_ARM32_USB_AUTOMOUNT

menuconfig BSP_USING_CH438
    bool "Using CH438 device"
    default n

if BSP_USING_CH438
config CH438_EXTUART0
    bool "Using Ch438 Port 0"
    default n

menu "Ch438 Port 0 Configuration"
    depends on CH438_EXTUART0

    config CH438_EXTUART0_BAUD
        int "Ch438 Port 0 Baud Rate."
        default 115200
        ---help---
            The configured BAUD of the CH438 EXTUART0.
endmenu

config CH438_EXTUART1
    bool "Using Ch438 Port 1"
    default n

menu "Ch438 Port 1 Configuration"
    depends on CH438_EXTUART1

    config CH438_EXTUART1_BAUD
        int "Ch438 Port 1 Baud Rate."
        default 115200
        ---help---
            The configured BAUD of the CH438 EXTUART1.
endmenu

config CH438_EXTUART2
    bool "Using Ch438 Port 2"
    default n

menu "Ch438 Port 2 Configuration"
    depends on CH438_EXTUART2

    config CH438_EXTUART2_BAUD
        int "Ch438 Port 2 Baud Rate."
        default 115200
        ---help---
            The configured BAUD of the CH438 EXTUART2.
endmenu

config CH438_EXTUART3
    bool "Using Ch438 Port 3"
    default n

menu "Ch438 Port 3 Configuration"
    depends on CH438_EXTUART3

    config CH438_EXTUART3_BAUD
        int "Ch438 Port 3 Baud Rate."
        default 115200
        ---help---
            The configured BAUD of the CH438 EXTUART3.
endmenu

config CH438_EXTUART4
    bool "Using Ch438 Port 4"
    default n

menu "Ch438 Port 4 Configuration"
    depends on CH438_EXTUART4

    config CH438_EXTUART4_BAUD
        int "Ch438 Port 4 Baud Rate."
        default 115200
        ---help---
            The configured BAUD of the CH438 EXTUART4.
endmenu

config CH438_EXTUART5
    bool "Using Ch438 Port 5"
    default n

menu "Ch438 Port 5 Configuration"
    depends on CH438_EXTUART5

    config CH438_EXTUART5_BAUD
        int "Ch438 Port 5 Baud Rate."
        default 115200
        ---help---
            The configured BAUD of the CH438 EXTUART5.
endmenu

config CH438_EXTUART6
    bool "Using Ch438 Port 6"
    default n

menu "Ch438 Port 6 Configuration"
    depends on CH438_EXTUART6

    config CH438_EXTUART6_BAUD
        int "Ch438 Port 6 Baud Rate."
        default 115200
        ---help---
            The configured BAUD of the CH438 EXTUART6.
endmenu

config CH438_EXTUART7
    bool "Using Ch438 Port 7"
    default n

menu "Ch438 Port 7 Configuration"
    depends on CH438_EXTUART7

    config CH438_EXTUART7_BAUD
        int "Ch438 Port 7 Baud Rate."
        default 115200
        ---help---
            The configured BAUD of the CH438 EXTUART7.
endmenu

endif # BSP_USING_CH438

endif # ARCH_BOARD_XIDATONG_ARM32
```
