## xiuos/APP_Framework/Applications/app_test/Kconfig
```kconfig
menu "test app"
    menuconfig USER_TEST
        bool "Enable application test function "
        default n

        if USER_TEST
            menuconfig USER_TEST_ADC
                bool "Config test adc"
                default n
                if USER_TEST_ADC
                    if ADD_XIZI_FEATURES
                        config ADC_DEV_DRIVER
                            string "Set ADC dev path"
                            default "/dev/adc1_dev"
                    endif
                endif

            menuconfig USER_TEST_DAC
                bool "Config test dac"
                default n
                if USER_TEST_DAC
                    if ADD_XIZI_FEATURES
                        config DAC_DEV_DRIVER
                            string "Set DAC dev path"
                            default "/dev/dac_dev"
                    endif
                endif

            menuconfig USER_TEST_FS
                bool "Config test fs with sd or usb"
                default n
                if USER_TEST_FS
                    if ADD_XIZI_FEATURES
                        config FPATH
                            string "Set test file path"
                            default "/test_file"
                    endif
                endif


            menuconfig USER_TEST_GPIO
                select BSP_USING_GPIO
                select RESOURCES_PIN
                select BSP_USING_LED
                select BSP_USING_KEY
                bool "Config test gpio with led and key"
                default n
                if USER_TEST_GPIO
                    if ADD_XIZI_FEATURES
                        config GPIO_DEV_DRIVER
                            string "Set gpio dev path"
                            default "/dev/pin_dev"
                    endif
                endif

            menuconfig USER_TEST_LORA
                select BSP_USING_UART
                select BSP_USING_GPIO
                select RESOURCES_PIN
                select BSP_USING_UART2
                select BSP_USING_LORA
                bool "Config test uart(loraE220)"
                default n
                if USER_TEST_LORA
                    if ADD_XIZI_FEATURES
                        config LORA_UART_DEV_DRIVER
                            string "Set uart dev path"
                            default "/dev/uart2_dev2"
                        config LORA_PIN_DEV_DRIVER
                            string "Set pin dev path"
                            default "/dev/pin_dev"
                    endif
                endif

            menuconfig USER_TEST_RS485
                select BSP_USING_UART
                select BSP_USING_GPIO
                select RESOURCES_PIN
                select BSP_USING_UART1
                bool "Config test uart(RS485)"
                default n
                if USER_TEST_RS485
                    if ADD_XIZI_FEATURES
                        config RS485_UART_DEV_DRIVER
                            string "Set uart dev path"
                            default "/dev/uart1_dev1"
                        config RS485_PIN_DEV_DRIVER
                            string "Set pin dev path"
                            default "/dev/pin_dev"
                    endif
                endif

            menuconfig USER_TEST_RTC
                select BSP_USING_RTC
                bool "Config test rtc"
                default n
                if USER_TEST_RTC
                    if ADD_XIZI_FEATURES
                        config RTC_DEV_DRIVER
                            string "Set rtc dev path"
                            default "/dev/rtc_dev"
                    endif
                endif

            menuconfig USER_TEST_HWTIMER
                select BSP_USING_HWTIMER
                select BSP_USING_GPIO
                select RESOURCES_PIN
                select BSP_USING_LED
                bool "Config test hwtimer"
                default n
                if USER_TEST_HWTIMER
                    if ADD_XIZI_FEATURES
                        config HWTIMER_TIMER_DEV_DRIVER
                            string "Set pin dev path"
                            default "/dev/timer0_dev0"
                        config HWTIMER_PIN_DEV_DRIVER
                            string "Set pin dev path"
                            default "/dev/pin_dev"
                    endif
                endif

            menuconfig USER_TEST_WDT
                select BSP_USING_WDT0
                bool "Config test watchdog"
                default n
                if USER_TEST_WDT
                    if ADD_XIZI_FEATURES
                        config WDT0_DEV_DRIVER
                            string "Set wdt dev path"
                            default "/dev/wdt0_dev0"
                    endif
                endif

            menuconfig USER_TEST_LCD_EDU
                select BSP_USING_LCD
                bool "Config test lcd in PrivOpen"
                default n
                if USER_TEST_LCD_EDU
                    if ADD_XIZI_FEATURES
                        config EDU_LCD_DEV_DRIVER
                            string "Set lcd dev path"
                            default "/dev/lcd_dev"
                    endif
                endif

            menuconfig USER_TEST_TOUCH
                select BSP_USING_TOUCH
                bool "Config test touch"
                default n
                if USER_TEST_TOUCH
                    if ADD_XIZI_FEATURES
                        config TOUCH_DEV_DRIVER
                            string "Set touch dev path"
                            default "/dev/touch_dev"
                        config TOUCH_LCD_DEV_DRIVER
                            string "Set lcd dev path"
                            default "/dev/lcd_dev"
                    endif
                endif

            menuconfig USER_TEST_I2C
                select BSP_USING_I2C
                bool "Config test i2c"
                default n
                if USER_TEST_I2C
                    if ADD_XIZI_FEATURES
                        config I2C_DEV_DRIVER
                            string "Set i2c dev path"
                            default "/dev/i2c1_dev0"
                    endif
                endif

            menuconfig USER_TEST_CAN
                select BSP_USING_CAN
                bool "Config test can"
                default n
                if USER_TEST_CAN
                    if ADD_XIZI_FEATURES
                        config CAN_DEV_DRIVER
                            string "Set can dev path"
                            default "/dev/can2_dev1"
                    endif
                endif

            menuconfig USER_TEST_CAMERA
                select BSP_USING_CAMERA
                select BSP_USING_LCD
                bool "Config test camera with lcd"
                default n
                if USER_TEST_CAMERA
                    if ADD_XIZI_FEATURES
                        config CAMERA_DEV_DRIVER
                            string "Set camera dev path"
                            default "/dev/camera_dev"
                        config CAMERA_LCD_DEV_DRIVER
                            string "Set lcd dev path"
                            default "/dev/lcd_dev"
                    endif
                endif

            config USER_TEST_SEMC
                bool "Config test semc sdram"
                default n

            config USER_TEST_LCD
                bool "Config test lcd device"
                default n

            menuconfig USER_TEST_ETHERNET
                bool "Config test ethernet only for edu-riscv64"
                default n
                if USER_TEST_ETHERNET
                    if ADD_XIZI_FEATURES
                        choice 
                            prompt "set ethernet role as client or server"
                            default ETHERNET_AS_SERVER

                            config ETHERNET_AS_SERVER
                            bool "test as server"

                            config ETHERNET_AS_CLIENT
                            bool "test as client"
                        endchoice
                    endif
                endif
            
            menuconfig USER_TEST_FLASH
                bool "Config test w25q128 device"
                default n
                if USER_TEST_FLASH
                    if ADD_XIZI_FEATURES
                        config FLASH_DEV_DRIVER
                            string "Set flash dev path"
                            default "/dev/qspi_W25Q128"
                    endif
                endif

            menuconfig USER_TEST_TIMER
                bool "Config test soft timer"
                default n

            menuconfig USER_TEST_HASH
                bool "Config test hash"
                default n

            menuconfig USER_TEST_RADIX
                bool "Config test radix tree"
                default n
            
            menuconfig USER_TEST_RBTREE
                bool "Config test red black tree"
                default n

            menuconfig USER_TEST_WEBSERVER
                bool "Config test webserver"
                default n

            menuconfig USER_TEST_MQTTCLIENT
                bool "Config test mqtt client"
                default n

            menuconfig USER_TEST_FTPCLIENT
                bool "Config test ftp client"
                default n
            
            menuconfig USER_TEST_LORA_P2P
                bool "Config test lora p2p"
                default n

            menuconfig USER_TEST_LORAWAN_SINGLEGW
                bool "Config test lorawan single channel gateway"
                default n

            menuconfig USER_TEST_CANOPEN
                bool "Config test CanOpen"
                default n

            menuconfig USER_TEST_USB_CAMERA
                bool "Config test usb camera"
                default n

        endif
endmenu
```

## xiuos/APP_Framework/Applications/connection_app/Kconfig
```kconfig
menu "connection app"

    menuconfig APPLICATION_CONNECTION
        bool "Using connection apps"
        default n

	if APPLICATION_CONNECTION
		menuconfig SOCKET_DEMO
		bool "Config test socket demo"
		default n
	endif

endmenu
```

## xiuos/APP_Framework/Framework/Kconfig
```kconfig
menu "Framework"

    config TRANSFORM_LAYER_ATTRIUBUTE
        bool "support transform layer"
        default y
        choice
            prompt "select os features"
            default ADD_XIZI_FEATURES

            config ADD_XIZI_FEATURES
                bool "add xizi features"
            
            config ADD_NUTTX_FEATURES
                bool "add nuttx features"

            config ADD_RTTHREAD_FEATURES
                bool "add rt_thread features"
        endchoice


    source "$APP_DIR/Framework/sensor/Kconfig"
    source "$APP_DIR/Framework/connection/Kconfig"
    source "$APP_DIR/Framework/knowing/Kconfig"
    source "$APP_DIR/Framework/control/Kconfig"
    source "$APP_DIR/Framework/security/Kconfig"


endmenu
```

## xiuos/APP_Framework/Framework/connection/4g/ec200t/Kconfig
```kconfig
config ADAPTER_4G_EC200T
        string "EC200T adapter name"
        default "ec200t"

if ADD_XIZI_FEATURES
        config ADAPTER_EC200T_USING_PWRKEY
                bool "EC200T using PWRKEY pin number"
                default n

        if ADAPTER_EC200T_USING_PWRKEY
                config ADAPTER_EC200T_PWRKEY
                        int "EC200T PWRKEY pin number"
                        default "97"

                config ADAPTER_EC200T_PIN_DRIVER
                        string "EC200T device pin driver path"
                        default "/dev/pin_dev"
        endif

        config ADAPTER_EC200T_DRIVER_EXTUART
                bool "Using extra uart to support 4G"
                default n

        config ADAPTER_EC200T_DRIVER
                string "EC200T device uart driver path"
                default "/dev/usart2_dev2"
                depends on !ADAPTER_EC200T_DRIVER_EXTUART

        if ADAPTER_EC200T_DRIVER_EXTUART                    
                config ADAPTER_EC200T_DRIVER
                        string "EC200T device extra uart driver path"
                        default "/dev/extuart_dev5"

                config ADAPTER_EC200T_DRIVER_EXT_PORT
                        int "if EC200T device using extuart, choose port"
                        default "5"
        endif
endif

if ADD_NUTTX_FEATURES
        config ADAPTER_EC200T_USING_PWRKEY
                bool "EC200T using PWRKEY pin number"
                default n

        if ADAPTER_EC200T_USING_PWRKEY
                config ADAPTER_EC200T_PWRKEY
                        int "EC200T PWRKEY pin number"
                        default "97"

                config ADAPTER_EC200T_PIN_DRIVER
                        string "EC200T device pin driver path"
                        default "/dev/gpio3"
        endif

        config ADAPTER_EC200T_DRIVER_EXTUART
                bool "Using extra uart to support 4G"
                default n

        config ADAPTER_EC200T_DRIVER
                string "EC200T device uart driver path"
                default "/dev/ttyS8"
                depends on !ADAPTER_EC200T_DRIVER_EXTUART

        if ADAPTER_EC200T_DRIVER_EXTUART                    
                config ADAPTER_EC200T_DRIVER
                        string "EC200T device extra uart driver path"
                        default "/dev/extuart_dev5"

                config ADAPTER_EC200T_DRIVER_EXT_PORT
                        int "if EC200T device using extuart, choose port"
                        default "5"
        endif
endif

if ADD_RTTHREAD_FEATURES
        config ADAPTER_EC200T_PWRKEY
                int "EC200T PWRKEY pin number"
                default "97"
        config ADAPTER_EC200T_PIN_DRIVER
                string "EC200T device pin driver path"
                default "/dev/pin_dev"

        config ADAPTER_EC200T_DRIVER_EXTUART
                bool "Using extra uart to support 4G"
                default n

        config ADAPTER_EC200T_DRIVER
                string "EC200T device uart driver path"
                default "/dev/usart8"
                depends on !ADAPTER_EC200T_DRIVER_EXTUART

        if ADAPTER_EC200T_DRIVER_EXTUART                    
                config ADAPTER_EC200T_DRIVER
                        string "EC200T device extra uart driver path"
                        default "/dev/extuart_dev5"

                config ADAPTER_EC200T_DRIVER_EXT_PORT
                        int "if EC200T device using extuart, choose port"
                        default "5"
        endif


endif
```

## xiuos/APP_Framework/Framework/connection/ethernet/hfa21_ethernet/Kconfig
```kconfig
config ADAPTER_ETHERNET_HFA21
        string "HFA21 ETHERNET adapter name"
        default "hfa21_ethernet"

if ADD_XIZI_FEATURES

        config ADAPTER_HFA21_DRIVER_EXTUART
                bool "Using extra uart to support ethernet"
                default n

        config ADAPTER_HFA21_DRIVER
                string "HFA21 device uart driver path"
                default "/dev/usart3_dev3"
                depends on !ADAPTER_HFA21_DRIVER_EXTUART

        if ADAPTER_HFA21_DRIVER_EXTUART                    
                config ADAPTER_HFA21_DRIVER
                        string "HFA21 device extra uart driver path"
                        default "/dev/extuart_dev6"

                config ADAPTER_HFA21_DRIVER_EXT_PORT
                        int "if HFA21 device using extuart, choose port"
                        default "6"
        endif
endif

if ADD_NUTTX_FEATURES

endif

if ADD_RTTHREAD_FEATURES
        config ADAPTER_HFA21_DRIVER
                string "HFA21 device uart driver path"
                default "/dev/uart3"
endif
```
